VERSION "1.0"

NS_ :

BS_:

BU_: DBG Controller_dsPIC

BO_ 256 Engine_Status: 8 Controller_dsPIC
 SG_ Engine_RPM : 0|16@1+ (0.25,0) [0|16383.75] "rpm" DBG
 SG_ Engine_Temp : 16|8@1- (1,0) [-128|127] "degC" DBG

BO_ 512 Vehicle_Speed_Info: 8 Controller_dsPIC
 SG_ Vehicle_Speed : 0|16@1+ (0.01,0) [0|655.35] "km/h" DBG

CM_ BU_ Controller_dsPIC "dsPIC33EV256GM106 Main Controller";
CM_ BO_ 256 "Engine real-time status message";
CM_ SG_ 256 Engine_RPM "Engine revolutions per minute";

BA_DEF_  "BusType" STRING ;
BA_DEF_DEF_  "BusType" "CAN";

VAL_ 256 Engine_Temp 0 "Normal" 100 "Overheat" 127 "Critical" ;
